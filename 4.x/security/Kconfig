## 4.x/security/myfun/Kconfig
```kconfig
config SECURITY_MYFUN
bool "Myfun security module"
      	default y
help
      	Any help text here
```

## 5.x/arch/s390/configs/defconfig
```kconfig
[...]
CONFIG_LSM = "myfun,yama,loadpin,safesetid,integrity,selinux,smack,tomoyo,apparmor"
[...]
```

## 5.x/security/Kconfig
```kconfig
[…]

source security/myfun/Kconfig

[…]

config DEFAULT_SECURITY_MYFUN
     bool "MyFun" if SECURITY_MYFUN=y

[…]

default "myfun,lockdown,yama,loadpin,safesetid,integrity,selinux,apparmor,tomoyo,bpf" if DEFAULT_SECURITY_MYFUN

[…]
```

## 5.x/security/myfun/Kconfig
```kconfig
config SECURITY_MYFUN
        bool "MyFun security module"
        depends on SECURITY
        default y
        help
                This option enables a simply printk hook
```
